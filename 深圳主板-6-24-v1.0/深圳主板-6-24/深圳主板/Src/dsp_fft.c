#include "table_fft.h"
#include "stm32_dsp.h"
#include "math.h"
#include "dsp_fft.h"


extern signed int ATT_UA[256];  //谐波UA
extern signed int ATT_UB[256];
extern signed int ATT_UC[256];
extern signed int ATT_IA[256];
extern signed int ATT_IB[256];
extern signed int ATT_IC[256];

float THD[6]={0};  //六个总谐波含量

int NPT=256;
long lBUFOUT[256];
long lBUFIN[256]={
6123,
5444,
4965,
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6411,
}; 
long lBUFMAG[256];
float Content_Hwave[32]={0};
float Content_Hwave_Gain[32]=
{
	1.0,
	1.00362187060665,
	1.00969162604172,
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	3.2643202,
	3.48424791
};






void powerMag(long nfill)  
{
  s16 lX,lY;
  uint32_t i;
	for (i=0; i < 256; i++)
  {
    lX= (lBUFOUT[i]<<16)>>16; 
    lY= (lBUFOUT[i] >> 16);
    {
      float X=  NPT*((float)lX)/32768;
      float Y = NPT*((float)lY)/32768;
			float Mag = sqrt((X*X+ Y*Y));		 
			Mag = (Mag/nfill);		
      lBUFMAG[i] = Mag*65536;		 
    }    
  }
}

void Harmonic_Content_Calculate(unsigned char ph)  //谐波含有率计算
{
	
	float harmonic_sum = 0.0;
	switch(ph)
	{
		case 0:
			for(int i=0;i<256;i++)  
			{
				lBUFIN[i]=((s16)ATT_UA[i])<<16;
			}
			break;
		case 1:
			for(int i=0;i<256;i++)  
			{
				lBUFIN[i]=((s16)ATT_UB[i])<<16;
			}
			break;
		case 2:
			for(int i=0;i<256;i++)  
			{
				lBUFIN[i]=((s16)ATT_UC[i])<<16;
			}
			break;
		case 3:
			for(int i=0;i<256;i++)  
			{
				lBUFIN[i]=((s16)ATT_IA[i])<<16;
			}
			break;
		case 4:
			for(int i=0;i<256;i++)  
			{
				lBUFIN[i]=((s16)ATT_IB[i])<<16;
			}
			break;
		case 5:
			for(int i=0;i<256;i++)  
			{
				lBUFIN[i]=((s16)ATT_IC[i])<<16;
			}
			break;
		default:
			break;
	}	
		cr4_fft_256_stm32(lBUFOUT, lBUFIN, 256);
		powerMag(NPT);
		for(int k=1;k<33;k++)
		{
			Content_Hwave[k+1]=Content_Hwave_Gain[k]*100*(float)lBUFMAG[4*(k+1)]/(float)lBUFMAG[4];
		}
		
		float V1 = lBUFMAG[4];  // 基波幅值
		for (int k = 1; k <= 33; k++)   //总谐波含有率
		{
			float Vk = (float)lBUFMAG[4 * (k + 1)];
			harmonic_sum += Vk * Vk;
    }

    THD[ph] = sqrt(harmonic_sum) / V1;
}
